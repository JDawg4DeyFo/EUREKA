## components/i2c/Kconfig
```kconfig
## I2C Kconfig file
# April 8th, 2025

menu "Project I2C configuration"

# Pin configurations
config I2C_MASTER_SCL
	int "I2C Master SCL GPIO Pin"
	default 22
	help
		The GPIO pin used by the i2c master serial clock line.

config I2C_MASTER_SDA
	int "I2C Master SDA GPIO Pin"
	default 21
	help
		The GPIO pin used by the i2c master serial data line.

# bit definitions
config I2C_MASTER_WRITE
	int "I2C Master Write Bit"
	default 0
	help
		The value of the 8th bit in a command frame indicating W operations.

config I2C_MASTER_READ
	int "I2C Master Read Bit"
	default 1
	help
		The value of the 8th bit in a command frame indicating R operations.

# ack/nack definitions
config I2C_MASTER_ACK
	int "I2C Master Acknowledge"
	default 0
	help
		The value of a master acknowledge bit

config I2C_MASTER_NACK
	int "I2C Master No_Acknowledge"
	default 1
	help
		The value of a master no_acknowledge bit

endmenu	
```

## components/sensors/Kconfig
```kconfig
## Sensor Library KConfig
# April 13, 2025

menu "Sensor Configurations"
config WINDVANE_GPIO
	int "GPIO pin used by the windvane"
	default 10
	help
		windvane is connected to ADC

config ANEMOMETER_GPIO
	int "GPIO pin used by the anemometer"
	default 11
	help
		The anemometer is connected to PCNT

	menu "I2C Configurations"
	# Pin configurations
	config I2C_MASTER_SCL
		int "I2C Master SCL GPIO Pin"
		default 42
		help
			The GPIO pin used by the i2c master serial clock line.

	config I2C_MASTER_SDA
		int "I2C Master SDA GPIO Pin"
		default 41
		help
			The GPIO pin used by the i2c master serial data line.

	config I2C_MASTER_FREQ
		int "I2C Master Frequency (Hz)"
		default 100000
		help
			Frequency of the I2C line, in Hz.

	config I2C_MASTER_TIMEOUT
		int "I2C Master timeout (ms)"
		default 1000
		help
			Time in miliseconds before master gives up on response.

	# bit definitions
	config I2C_MASTER_WRITE
		int "I2C Master Write Bit"
		default 0
		help
			The value of the 8th bit in a command frame indicating W operations.

	config I2C_MASTER_READ
		int "I2C Master Read Bit"
		default 1
		help
			The value of the 8th bit in a command frame indicating R operations.

	# ack/nack definitions
	config I2C_MASTER_ACK
		int "I2C Master Acknowledge"
		default 0
		help
			The value of a master acknowledge bit

	config I2C_MASTER_NACK
		int "I2C Master No_Acknowledge"
		default 1
		help
			The value of a master no_acknowledge bit

	endmenu
endmenu
```

## components/timer/Kconfig
```kconfig
## Timer Library KConfig
# April 13, 2025

menu "Project timer configuration"
config GPT_RESOLUTION
	int "General purpose timer resolution (Hz)"
	default 1000000
	help
		Resolution in Hertz of the general purpose timer.


endmenu
```

## main/Kconfig
```kconfig
## CONDITIONAL BUILD FLAGS
# Sensors test harness
choice
	prompt "Select build version"

config SENSOR_LIB_TEST
	bool "Build sensor test harness"
	default y

config PCNT_TEST
	bool "Build Pulse Count test harness"

config POWER_TEST
	bool "Build power test harness"

config SENSOR_NODE_MAIN
	bool "Build main() for sensor node"

config CLUSTER_HEAD_MAIN
	bool "Build main() for cluster head"

config JACOB_LORA
	bool "Build Jacob's Lora test"

config NEW_DRIVER_TEST
	bool "Build test harness for new driver"

config PINGPONG_TEST
	bool "Build Ping Pong test"

config FOREST_PATHLOSS_TEST
	bool "Build Path Loss in a Forested Environment test"

config LORA_CAD_TEST
	bool "Build LoRa Channel Activity Detection test"

config MONITOR_TEST
	bool "Build test for INA219"
config MEMORY_LIB_TEST
	bool "Build Memory Library test"
	
endchoice

config DEBUG_STUFF
	bool "Debug stuff"
	default n


menu "New Driver Test Application Configuration"

	choice DIRECTION
		prompt "Communication polarity"
		default SENDER
		help
			Select Communication polarity.
		config SENDER
			bool "As the sender"
			help
				As the sender.
		config RECEIVER
			bool "As the receiver"
			help
				As the receiver.
	endchoice

endmenu 

menu "Ping Pong Application Configuration"

	choice POLARITY
		prompt "Communication Polarity"
		default PRIMARY
		help
			Select Communication Polarity.
		config PRIMARY
			bool "Primary"
			help
				As Echo Client.
		config SECONDARY
			bool "Secondary"
			help
				As Echo Server.
	endchoice

endmenu 
```
